## hpm6800/Kconfig.liteos_m.soc
```kconfig
# Copyright (c) 2022 HPMicro.
# Licensed under the Apache License, Version 2.0 (the "License");
# you may not use this file except in compliance with the License.
# You may obtain a copy of the License at
#
#     http://www.apache.org/licenses/LICENSE-2.0
#
# Unless required by applicable law or agreed to in writing, software
# distributed under the License is distributed on an "AS IS" BASIS,
# WITHOUT WARRANTIES OR CONDITIONS OF ANY KIND, either express or implied.
# See the License for the specific language governing permissions and
# limitations under the License.

choice
    prompt "HPM6800 series SoC Selection"
    depends on SOC_SERIES_HPM6800
    default SOC_HPM6880

config SOC_HPM6880
    bool "HPM6880"

endchoice
```
